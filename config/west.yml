## config/west.yml
```yaml
manifest:
  remotes:
  - name: zmkfirmware
    url-base: https://github.com/zmkfirmware
  - name: zmk-smart-toggle-base
    url-base: https://github.com/caksoylar
  projects:
  - name: zmk
    remote: zmkfirmware
    revision: v0.3.0
    import: app/west.yml
  - name: zmk-keyboards-totem
    url: https://github.com/victorlucachi/zmk-keyboards-totem
    revision: main
    path: modules/zmk-keyboards-totem
  - name: zmk-smart-toggle
    remote: zmk-smart-toggle-base
    revision: main
  self:
    path: config
```
